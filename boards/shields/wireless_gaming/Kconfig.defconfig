## boards/shields/wireless_gaming/Kconfig.defconfig
```kconfig
if SHIELD_wireless_gaming

config ZMK_KEYBOARD_NAME
    default "wireless_gaming"

endif
```

## boards/shields/wireless_gaming/Kconfig.shield
```kconfig
config SHIELD_wireless_gaming
    def_bool $(shields_list_contains,wireless_gaming)
```

## boards/shields/wireless_left/Kconfig.defconfig
```kconfig
if SHIELD_wireless_left_LEFT

config ZMK_KEYBOARD_NAME
    default "wireless_left"

config ZMK_SPLIT_ROLE_CENTRAL
    default y

endif # SHIELD_wireless_left_LEFT

if SHIELD_wireless_left_LEFT || SHIELD_wireless_left_RIGHT

config ZMK_SPLIT
    default y

config SPI
    default y

config ZMK_RGB_UNDERGLOW
    select WS2812_STRIP
    select SPI

endif # SHIELD_wireless_left_LEFT || SHIELD_wireless_left_RIGHT
```

## boards/shields/wireless_left/Kconfig.shield
```kconfig
config SHIELD_wireless_left_LEFT
    def_bool $(shields_list_contains,wireless_left_left)

config SHIELD_wireless_left_RIGHT
    def_bool $(shields_list_contains,wireless_left_right)
```

## config/west.yml
```yaml
manifest:
  remotes:
    - name: zmkfirmware
      url-base: https://github.com/zmkfirmware
    - name: MyBestFriendMe
      url-base: https://github.com/MyBestFriendMe

    # Additional modules containing boards/shields/custom code can be listed here as well
    # See https://docs.zephyrproject.org/3.2.0/develop/west/manifest.html#projects
  projects:
    - name: zmk
      remote: zmkfirmware
      revision: main
      import: app/west.yml
    - name: gametest
      remote: MyBestFriendMe
      url: https://github.com/MyBestFriendMe/zmk-config.git
      revision: main
      import: 
  self:
    path: config
```
